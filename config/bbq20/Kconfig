## config/bbq20/Kconfig
```kconfig
# Copyright (c) 2023 ZitaoTech
# SPDX-License-Identifier: MIT

config BOARD_ENABLE_DCDC
    bool "Enable DCDC mode"
    select SOC_DCDC_NRF52X
    default y if BOARD_BBQ20
    default n if BOARD_NICE_NANO_V2  # 为 nice_nano_v2 添加默认值
```

## config/bbq20/Kconfig.defconfig
```kconfig
# Copyright (c) 2023 ZitaoTech
# SPDX-License-Identifier: MIT

if BOARD_BBQ20

config ZMK_KEYBOARD_NAME
    default "bbq20"

if USB_DEVICE_STACK

config USB_NRFX
    default y

endif # USB_DEVICE_STACK

if ZMK_BACKLIGHT

config PWM
    default y

config LED_PWM
    default y

endif # ZMK_BACKLIGHT

config BT_CTLR
    default BT

config ZMK_STUDIO
    bool "Enable ZMK Studio support"
    default y

config ZMK_PM_SOFT_OFF
    bool "Enable soft power-off feature"
    default y

endif # BOARD_BBQ20
```
